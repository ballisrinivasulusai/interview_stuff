/*@!Encoding:1252*/
includes
{
  
}

variables
{
  message diagreq d;
}
on sysvar SysVar::Diag::session
{
  if(@this==1)
  {
    d.byte(0)=0x02;
    d.byte(1)=0x10;
    d.byte(2)=0x01;
    output(d);
  }
  
 if(@this==2)
  {
    d.byte(0)=0x02;
    d.byte(1)=0x10;
    d.byte(2)=0x02;
    output(d);
  }
    
    
     if(@this==3)
  {
    d.byte(0)=0x02;
    d.byte(1)=0x10;
    d.byte(2)=0x03;
    output(d);
  }
}



on sysvar SysVar::Diag::reset
{
  if(@this==1)
  {
    d.byte(0)=0x02;
    d.byte(1)=0x11;
    d.byte(2)=0x01;
    output(d);
  }
  
 if(@this==2)
  {
    d.byte(0)=0x02;
    d.byte(1)=0x11;
    d.byte(2)=0x02;
    output(d);
  }
    
    
     if(@this==3)
  {
    d.byte(0)=0x02;
    d.byte(1)=0x11;
    d.byte(2)=0x03;
    output(d);
  }
}


on sysvar SysVar::Diag::readdtcinfo
{
  if(@this==1)
  {
    d.byte(0)=0x02;
    d.byte(1)=0x19;
    d.byte(2)=0x01;
    output(d);
  }
  
 if(@this==2)
  {
    d.byte(0)=0x02;
    d.byte(1)=0x19;
    d.byte(2)=0x02;
    output(d);
  }
    
    
     if(@this==3)
  {
    d.byte(0)=0x02;
    d.byte(1)=0x19;
    d.byte(2)=0x04;
    output(d);
  }
}

on sysvar SysVar::Diag::readDID
{
  if(@this==1)
  {
    d.byte(0)=0x02;
    d.byte(1)=0x22;
    d.byte(2)=0x01;
    output(d);
  }
  
 if(@this==2)
  {
    d.byte(0)=0x02;
    d.byte(1)=0x22;
    d.byte(2)=0x02;
    output(d);
  }
    
    
     if(@this==3)
  {
    d.byte(0)=0x02;
    d.byte(1)=0x22;
    d.byte(2)=0x03;
    output(d);
  }
}
  
on sysvar SysVar::Diag::securityaccess
 {   
  if(@this==1)
  {
    d.byte(0)=0x02;
    d.byte(1)=0x27;
    d.byte(2)=0x01;
    output(d);
  }
  
}

on sysvar SysVar::Diag::Routinecontrol
{
  if(@this==1)
  {
    d.byte(0)=0x02;
    d.byte(1)=0x31;
    d.byte(2)=0x01;
    output(d);
  }
}



